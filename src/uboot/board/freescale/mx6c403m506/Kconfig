## src/uboot/board/freescale/mx6c403m506/Kconfig
```kconfig
if TARGET_MX6C403M506

config SYS_BOARD
	default "mx6c403m506"

config SYS_VENDOR
	default "freescale"

config SYS_CONFIG_NAME
	default "mx6c403m506"

endif
```

## src/uboot/board/freescale/mx6c403m704/Kconfig
```kconfig
if TARGET_MX6C403M704

config SYS_BOARD
	default "mx6c403m704"

config SYS_VENDOR
	default "freescale"

config SYS_CONFIG_NAME
	default "mx6c403m704"

endif
```

## src/uboot/board/freescale/mx6uls607/Kconfig
```kconfig
if TARGET_MX6ULS607

config SYS_BOARD
	default "mx6uls607"

config SYS_VENDOR
	default "freescale"

config SYS_CONFIG_NAME
	default "mx6uls607"

endif
```

## src/uboot/board/freescale/mx6uls707/Kconfig
```kconfig
if TARGET_MX6ULS707

config SYS_BOARD
	default "mx6uls707"

config SYS_VENDOR
	default "freescale"

config SYS_CONFIG_NAME
	default "mx6uls707"

endif
```

## src/uboot/configs/mx6c403m506_W97BH2MBVA1I_400_defconfig
```kconfig
CONFIG_ARM=y
CONFIG_ARCH_MX6=y
CONFIG_TARGET_MX6C403M506=y
CONFIG_SYS_EXTRA_OPTIONS="IMX_CONFIG=board/freescale/mx6c403m506/mx6q_W97BH2MBVA1I_2gb_528.cfg,MX6Q,W97BH2LBVX2I"
CONFIG_CMD_GPIO=y
```

## src/uboot/configs/mx6c403m506_defconfig
```kconfig
CONFIG_ARM=y
CONFIG_ARCH_MX6=y
CONFIG_TARGET_MX6C403M506=y
CONFIG_SYS_EXTRA_OPTIONS="IMX_CONFIG=board/freescale/mx6c403m506/mx6q_c403_2GB.cfg,MX6Q"
CONFIG_CMD_GPIO=y
```

## src/uboot/configs/mx6c403m506_w97a_defconfig
```kconfig
CONFIG_ARM=y
CONFIG_ARCH_MX6=y
CONFIG_TARGET_MX6C403M506=y
#CONFIG_SYS_EXTRA_OPTIONS="IMX_CONFIG=board/freescale/mx6c403m506/mx6q_4x_mt41j128.cfg,MX6Q"
#CONFIG_SYS_EXTRA_OPTIONS="IMX_CONFIG=board/freescale/mx6c403m506/mx6q_W97BH2LBVX2I-2gb.cfg,MX6Q"
CONFIG_SYS_EXTRA_OPTIONS="IMX_CONFIG=board/freescale/mx6c403m506/mx6q_W97AH2KBVX2I_1gb.cfg,MX6Q,W97AH2KBVX2I"
#CONFIG_SYS_EXTRA_OPTIONS="IMX_CONFIG=board/freescale/mx6c403m506/mx6q_W979H2KBVX2I_512mb.cfg,MX6Q"
CONFIG_CMD_GPIO=y
```

## src/uboot/configs/mx6c403m704_defconfig
```kconfig
CONFIG_ARM=y
CONFIG_ARCH_MX6=y
CONFIG_TARGET_MX6C403M704=y
CONFIG_SYS_EXTRA_OPTIONS="IMX_CONFIG=board/freescale/mx6c403m704/mx6q_c403_2GB.cfg,MX6Q,M704"
CONFIG_CMD_GPIO=y
```
